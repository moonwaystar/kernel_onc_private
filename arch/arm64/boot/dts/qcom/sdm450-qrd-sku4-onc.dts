/*
 * Copyright (c) 2018-2019, The Linux Foundation. All rights reserved.
 * Copyright (C) 2020-2024 XiaoMi, Inc.
 *
 * This program is free software; you can redistribute it and/or modify
 * it under the terms of the GNU General Public License version 2 and
 * only version 2 as published by the Free Software Foundation.
 */

/dts-v1/;

#include "msm8953.dtsi"
#include "pmi632.dtsi"
#include "msm8953-pinctrl.dtsi"
#include "msm8953-mdss-panels.dtsi"
#include "sdm450-pmi632.dtsi"
#include "sdm450-qrd-sku4.dtsi"

#include "onc/onc-msm8953-mtp-overlay.dtsi"
#include "onc/onc-base.dtsi"

/ {
	model = "Qualcomm Technologies, Inc. SDM632 + PMI632 SOC";
	compatible = "qcom,sdm450";
	qcom,pmic-id = <0x010016 0x25 0x0 0x0>;
	qcom,pmic-name = "PMI632";
};
