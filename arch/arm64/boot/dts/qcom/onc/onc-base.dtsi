/*
 * Copyright (c) 2017-2019, The Linux Foundation. All rights reserved.
 * Copyright (C) 2020-2024 XiaoMi, Inc.
 *
 * This program is free software; you can redistribute it and/or modify
 * it under the terms of the GNU General Public License version 2 and
 * only version 2 as published by the Free Software Foundation.
 */

#include "onc-msm8953-audio.dtsi"
#include "onc-msm8953-camera-sensor-mtp.dtsi"
#include "onc-msm8953-mdss-panels.dtsi"
#include "onc-msm8953-mtp.dtsi"
#include "onc-msm8953-pinctrl.dtsi"
#include "onc-msm8953-regulator.dtsi"
#include "onc-msm8953-thermal.dtsi"
#include "onc-msm8953.dtsi"
#include "onc-pm8953.dtsi"
#include "onc-pmi632.dtsi"
#include "onc-sdm450-pmi632.dtsi"
#include "onc-sdm450-qrd-sku4.dtsi"
