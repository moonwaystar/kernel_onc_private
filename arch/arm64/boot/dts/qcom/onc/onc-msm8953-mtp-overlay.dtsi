/*
 * Copyright (c) 2018, The Linux Foundation. All rights reserved.
 * Copyright (C) 2020-2024 XiaoMi, Inc.
 *
 * This program is free software; you can redistribute it and/or modify
 * it under the terms of the GNU General Public License version 2 and
 * only version 2 as published by the Free Software Foundation.
 */

/ {
	/delete-node/ vendor;
	/delete-node/ qpnp_fg;
	/delete-node/ pmi_haptic;
	/delete-node/ qpnp_smbcharger;
};

&spi_6 {
	status = "ok";
	device@1 {
		compatible = "ererl,ir2661cl510";
		#address-cells = <1>;
		#size-cells = <1>;
		reg = <1>;
		spi-max-frequency = <1000000>;
		spi-cpol;
	};
};
