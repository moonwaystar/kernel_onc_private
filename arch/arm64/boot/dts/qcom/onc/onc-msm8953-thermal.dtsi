/*
 * Copyright (c) 2018, The Linux Foundation. All rights reserved.
 * Copyright (C) 2020-2024 XiaoMi, Inc.
 *
 * This program is free software; you can redistribute it and/or modify
 * it under the terms of the GNU General Public License version 2 and
 * only version 2 as published by the Free Software Foundation.
 */

&thermal_zones {
	/* Add quiet_therm node */
	quiet-therm-adc {
		polling-delay-passive = <0>;
		polling-delay = <0>;
		thermal-sensors = <&pm8953_adc_tm 0x11>;
		thermal-governor = "user_space";
		trips {
				active-config0 {
				temperature = <65000>;
				hysteresis = <5000>;
				type = "passive";
				};
		};
	};
};
